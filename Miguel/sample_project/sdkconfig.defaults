## gerhardus/ov3360_usb_gerhard/sdkconfig.defaults
```kconfig
# Target ESP32-S3
CONFIG_IDF_TARGET="esp32s3"

# CPU Frequency 240MHz for max performance
CONFIG_ESP32S3_DEFAULT_CPU_FREQ_240=y
CONFIG_ESP32S3_DEFAULT_CPU_FREQ_MHZ=240

# Octal PSRAM Configuration (N16R8)
CONFIG_SPIRAM=y
CONFIG_SPIRAM_MODE_OCT=y
CONFIG_SPIRAM_TYPE_AUTO=y
CONFIG_SPIRAM_SIZE=-1
CONFIG_SPIRAM_SPEED_80M=y
CONFIG_SPIRAM_USE_MALLOC=y
CONFIG_SPIRAM_MALLOC_ALWAYSINTERNAL=16384
CONFIG_SPIRAM_MALLOC_RESERVE_INTERNAL=32768

# FreeRTOS 1000Hz Ticks
CONFIG_FREERTOS_HZ=1000

# Main Task Stack Size
CONFIG_ESP_MAIN_TASK_STACK_SIZE=16384

# Wi-Fi / LwIP Performance tuning
CONFIG_LWIP_MAX_SOCKETS=10
CONFIG_LWIP_SO_REUSE=y
CONFIG_LWIP_TCP_NODELAY=y
CONFIG_LWIP_TCP_MSS=1440
CONFIG_LWIP_TCP_SND_BUF_DEFAULT=32768
CONFIG_LWIP_TCP_WND_DEFAULT=32768

# Compiler Optimization
CONFIG_COMPILER_OPTIMIZATION_PERF=y

# Wi-Fi Credentials
CONFIG_ESP_WIFI_SSID="Kitty"
CONFIG_ESP_WIFI_PASSWORD="Swartkat"
```

## ov3360_usb/main/Kconfig.projbuild
```kconfig
menu "Wi-Fi & Object Detection Rig Configuration"

    config ESP_WIFI_SSID
        string "Wi-Fi SSID"
        default "Kitty"
        help
            SSID of the Wi-Fi network the ESP32-S3 should connect to.

    config ESP_WIFI_PASSWORD
        string "Wi-Fi Password"
        default "Swartkat"
        help
            Password for the Wi-Fi network.

    config ESP_WIFI_MAXIMUM_RETRY
        int "Maximum Wi-Fi Connect Retries"
        default 10
        help
            Maximum retry attempts before reporting Wi-Fi failure.

    config TCP_SERVER_PORT
        int "TCP Server Port"
        default 8888
        help
            TCP port for PC client to connect and stream frames.

    config DEFAULT_STAGE_MODE
        int "Default Stage Mode (1 = Results only, 2 = Echo Frame)"
        range 1 2
        default 1
        help
            Default operational stage:
            Stage 1: PC sends JPEG -> ESP32 detects -> ESP32 returns bounding box results.
            Stage 2: PC sends JPEG -> ESP32 detects -> ESP32 returns bounding box results AND echoes the JPEG frame back.

    config DETECTOR_CONFIDENCE_THRESHOLD
        int "Object Detection Confidence Threshold (%)"
        range 1 100
        default 50
        help
            Minimum confidence percentage (0-100) to accept a detected object.

endmenu
```
